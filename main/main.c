#include "driver/gpio.h"
#include "driver/i2c.h"
#include "esp_err.h"
#include "esp_log.h"
#include "freertos/task.h"

#include "sdkconfig.h" // generated by "make menuconfig"

#include "bme280.h"

#define SDA_PIN GPIO_NUM_15
#define SCL_PIN GPIO_NUM_2
#define BME280_ADDRESS BME280_I2C_ADDR_SEC

#define TAG_BME280 "BME280"

#define I2C_MASTER_ACK 0
#define I2C_MASTER_NACK 1

#define BME280_CALLBACK_OK 0
#define BME280_CALLBACK_FAIL -1

void i2c_master_init()
{
	i2c_config_t i2c_config = {
		.mode = I2C_MODE_MASTER,
		.sda_io_num = SDA_PIN,
		.scl_io_num = SCL_PIN,
		.sda_pullup_en = GPIO_PULLUP_ENABLE,
		.scl_pullup_en = GPIO_PULLUP_ENABLE,
		.master.clk_speed = 40000
	};
	i2c_param_config(I2C_NUM_0, &i2c_config);
	i2c_driver_install(I2C_NUM_0, I2C_MODE_MASTER, 0, 0, 0);
}

uint8_t BME280_I2C_bus_write(uint8_t dev_addr, uint8_t reg_addr, uint8_t *reg_data, uint16_t cnt)
{
	int8_t iError = 0;

	esp_err_t espRc;
	i2c_cmd_handle_t cmd = i2c_cmd_link_create();

	i2c_master_start(cmd);
	i2c_master_write_byte(cmd, (dev_addr << 1) | I2C_MASTER_WRITE, true);

	i2c_master_write_byte(cmd, reg_addr, true);
	i2c_master_write(cmd, reg_data, cnt, true);
	i2c_master_stop(cmd);

	espRc = i2c_master_cmd_begin(I2C_NUM_0, cmd, 10/portTICK_PERIOD_MS);
	if (espRc == ESP_OK) {
		iError = BME280_CALLBACK_OK;
	} else {
		iError = BME280_CALLBACK_FAIL;
	}
	i2c_cmd_link_delete(cmd);

	return iError;
}

int8_t BME280_I2C_bus_read(uint8_t dev_addr, uint8_t reg_addr, uint8_t *reg_data, uint16_t cnt)
{
	int8_t iError = 0;
	esp_err_t espRc;

	i2c_cmd_handle_t cmd = i2c_cmd_link_create();

	i2c_master_start(cmd);
	i2c_master_write_byte(cmd, (dev_addr << 1) | I2C_MASTER_WRITE, true);
	i2c_master_write_byte(cmd, reg_addr, true);

	i2c_master_start(cmd);
	i2c_master_write_byte(cmd, (dev_addr << 1) | I2C_MASTER_READ, true);

	if (cnt > 1) {
		i2c_master_read(cmd, reg_data, cnt-1, I2C_MASTER_ACK);
	}
	i2c_master_read_byte(cmd, reg_data+cnt-1, I2C_MASTER_NACK);
	i2c_master_stop(cmd);

	espRc = i2c_master_cmd_begin(I2C_NUM_0, cmd, 10/portTICK_PERIOD_MS);
	if (espRc == ESP_OK) {
		iError = BME280_CALLBACK_OK;
	} else {
		iError = BME280_CALLBACK_FAIL;
	}

	i2c_cmd_link_delete(cmd);

	return iError;
}

void BME280_delay_msek(uint32_t msek)
{
	vTaskDelay(msek/portTICK_PERIOD_MS);
}


void task_bme280_normal_mode(void *ignore)
{
	struct bme280_dev bme280 = {
		.write = BME280_I2C_bus_write,
		.read = BME280_I2C_bus_read,
		.intf = BME280_I2C_INTF,
		.dev_id = BME280_ADDRESS,
		.delay_ms = BME280_delay_msek
	};

	int32_t com_rslt;
	uint8_t settings_sel;
	struct bme280_data comp_data;

	com_rslt = bme280_init(&bme280);

	bme280.settings.osr_p = BME280_OVERSAMPLING_16X;
	bme280.settings.osr_t = BME280_OVERSAMPLING_2X;
	bme280.settings.osr_h = BME280_OVERSAMPLING_1X;
	bme280.settings.filter = BME280_FILTER_COEFF_16;
	bme280.settings.standby_time = BME280_STANDBY_TIME_1_MS;

	settings_sel = BME280_OSR_PRESS_SEL;
	settings_sel |= BME280_OSR_TEMP_SEL;
	settings_sel |= BME280_OSR_HUM_SEL;
	settings_sel |= BME280_STANDBY_SEL;
	settings_sel |= BME280_FILTER_SEL;

	com_rslt += bme280_set_sensor_settings(settings_sel, &bme280);
	com_rslt += bme280_set_sensor_mode(BME280_NORMAL_MODE, &bme280);
				
	if (com_rslt == BME280_OK) {
		while(true) {
			bme280.delay_ms(40);

			com_rslt = bme280_get_sensor_data(BME280_ALL, &comp_data, &bme280);

			if (com_rslt == BME280_OK) {
				ESP_LOGI(TAG_BME280, "%0.2f degC / %.2f kPa / %.2f %%", comp_data.temperature/100.0, comp_data.pressure/100.0, comp_data.humidity/1024.0);
			} else {
				ESP_LOGE(TAG_BME280, "measure error. code: %d", com_rslt);
			}
		}
	} else {
		ESP_LOGE(TAG_BME280, "init or setting error. code: %d", com_rslt);
	}

	vTaskDelete(NULL);
}

void task_bme280_forced_mode(void *ignore) {
		struct bme280_dev bme280 = {
		.write = BME280_I2C_bus_write,
		.read = BME280_I2C_bus_read,
		.intf = BME280_I2C_INTF,
		.dev_id = BME280_ADDRESS,
		.delay_ms = BME280_delay_msek
	};

	int32_t com_rslt;
	uint8_t settings_sel;
	struct bme280_data comp_data;

	com_rslt = bme280_init(&bme280);

	bme280.settings.osr_p = BME280_OVERSAMPLING_16X;
	bme280.settings.osr_t = BME280_OVERSAMPLING_2X;
	bme280.settings.osr_h = BME280_OVERSAMPLING_1X;
	bme280.settings.filter = BME280_FILTER_COEFF_16;

	settings_sel = BME280_OSR_PRESS_SEL | BME280_OSR_TEMP_SEL | BME280_OSR_HUM_SEL | BME280_FILTER_SEL;

	com_rslt += bme280_set_sensor_settings(settings_sel, &bme280);
				
	if (com_rslt == BME280_OK) {
		while(true) {
			com_rslt = bme280_set_sensor_mode(BME280_FORCED_MODE, &bme280);

			bme280.delay_ms(40);

			com_rslt = bme280_get_sensor_data(BME280_ALL, &comp_data, &bme280);

			if (com_rslt == BME280_OK) {
				ESP_LOGI(TAG_BME280, "%0.2f degC / %.2f kPa / %.2f %%", comp_data.temperature/100.0, comp_data.pressure/100.0, comp_data.humidity/1024.0);
			} else {
				ESP_LOGE(TAG_BME280, "measure error. code: %d", com_rslt);
			}
		}
	} else {
		ESP_LOGE(TAG_BME280, "init or setting error. code: %d", com_rslt);
	}

	vTaskDelete(NULL);
}

void app_main(void)
{
	i2c_master_init();
	xTaskCreate(&task_bme280_normal_mode, "bme280_normal_mode",  2048, NULL, 6, NULL);
	// xTaskCreate(&task_bme280_forced_mode, "bme280_forced_mode",  2048, NULL, 6, NULL);
}
